## components/gpiox/Kconfig.projbuild
```kconfig
menu "GPIO Expander Configuration"

config GPIOX_EXPANDERS
    bool "Support GPIO expanders"

endmenu
```

## components/iot/Kconfig.projbuild
```kconfig
menu "IOT Configuration"

config WIFI_SSID
    string "WiFi SSID"
    default "myssid"
    help
        SSID (network name) for the example to connect to.

config WIFI_PASSWORD
    string "WiFi Password"
    default "mypassword"
    help
        WiFi password (WPA or WPA2) for the example to use.

        Can be left blank if the network has no security set.

config MQTT_HOST
    string "MQTT Server"
    help
        Hostname/IP address of the MQTT server to connect to.

config MQTT_PORT
    int "MQTT Port"
    range 1 65536
    default 1883
    help
        Port to connect to on the MQTT server.

config MQTT_USERNAME
    string "MQTT Username"
    help
        Username used to connect to the MQTT server or blank if not required

config MQTT_PASSWORD
    string "MQTT Password"
    help
        Password used to connect to the MQTT server or blank if not required    
endmenu
```

## components/iot/kconfig.projbuild
```kconfig
menu "IOT"

    config ENABLE_HOMEASSISTANT_DISCOVERY
        bool "Enable Home Assistant Discovery"
        default y
        help
            This enables sending of configuration information to the home assistant MQTT Discovery topic.
endmenu
    
```

## components/relay/Kconfig.projbuild
```kconfig
menu "Relay Configuration"

config RELAY_ON_HIGH
    bool "Relay switches on high signal?"
    

endmenu
```

## components/sensors/Kconfig.projbuild
```kconfig
menu "Supported Sensors"

    config DHT22
        bool "Enable DHT22 support"
    
    config BME280
        bool "Enable BME280 (or BMP280) support"
    
    config SI7021
        bool "Enable SI7021 support"
    
    config DS18x20
        bool "Enabled DS18x20 support"
    
    config TSL2561
        bool "Enable TSL2561 support"
endmenu
```

## components/updater/Kconfig.projbuild
```kconfig
menu "Updater Configuration"

config UPDATER_HOST
    string "Updater Server"
    help
        Hostname/IP address of the Updater server to connect to.

config UPDATER_PORT
    int "Updater Port"
    range 1 65536
    default 80
    help
        Port to connect to on the Updater server.    

config UPDATER_PATH_PREFIX
    string "Path Prefix"
    help
        Path prefix to access the update images. 
        The prefix will be combined with the room name and the version to 
        update to and then either the a or b image depending on what 
        partition will be used for the new image:
        
        <prefix>/<room>/<update version>/<a|b image>
endmenu
```

## main/Kconfig.projbuild
```kconfig
menu "Thing Configuration"

config DHT22
    bool "Enable DHT22 support"

config BME280
    bool "Enable BME280 (or BMP280) support"

config SI7021
    bool "Enable SI7021 support"

config DS18x20
    bool "Enabled DS18x20 support"
    
config HUMIDISTAT
    bool "Enable Humidistat Fan support"
    
config HUMIDISTAT_THRESHOLD
    int "Percent Relative Humidity at which to turn on the fan"
    default 75
    range 0 100
    depends on HUMIDISTAT

config NOTIFICATION_LED
    bool "Enable notification LED"

config NOTIFICATION_LED_PIN
    int "GPIO pin for LED"
    depends on NOTIFICATION_LED
    range 0 16
    default 2

config HOMEASSISTANT
    bool "Enable Home Assistant Discovery support"
    
config DRAYTONSCR
    bool "Enable Drayton SCR transmit support"
endmenu
```

## sdkconfig.defaults
```kconfig
CONFIG_PARTITION_TABLE_TWO_OTA=y
CONFIG_PARTITION_TABLE_FILENAME="partitions_two_ota.csv"

CONFIG_DHT22=y
CONFIG_HUMIDISTAT=y
CONFIG_HUMIDISTAT_THRESHOLD=75
CONFIG_NOTIFICATION_LED=y
CONFIG_NOTIFICATION_LED_PIN=2
CONFIG_GPIOX_EXPANDERS=y
CONFIG_HOMEASSISTANT=y

CONFIG_EVENT_LOOP_STACK_SIZE=3072
CONFIG_OTA_ALLOW_HTTP=y
CONFIG_FREERTOS_TIMER_STACKSIZE=3072

CONFIG_FREERTOS_USE_TRACE_FACILITY=y
CONFIG_FREERTOS_USE_STATS_FORMATTING_FUNCTIONS=y
CONFIG_FREERTOS_GENERATE_RUN_TIME_STATS=y
CONFIG_FREERTOS_RUN_TIME_STATS_USING_ESP_TIMER=y

CONFIG_ENABLE_MDNS=y
CONFIG_MDNS_MAX_SERVICES=10
CONFIG_MDNS_STACKSIZE=4096

CONFIG_NEWLIB_LIBRARY_LEVEL_NORMAL=y
CONFIG_ESP_SHA=y
```
